## config/boards/shields/adjustment34/Kconfig.shield
```kconfig
config SHIELD_ADJUSTMENT34_LEFT
	def_bool $(shields_list_contains,adjustment34_left)

config SHIELD_ADJUSTMENT34_RIGHT
	def_bool $(shields_list_contains,adjustment34_right)
```
